## arch/arm/mach-rk3188/Kconfig
```kconfig
choice
	prompt "Rockchip SoC Type"
	depends on ARCH_RK3188

config SOC_RK3188
	bool "RK3188"
	select USB_ARCH_HAS_EHCI if USB_SUPPORT

config SOC_RK3188M
	bool "RK3188M"
	select USB_ARCH_HAS_EHCI if USB_SUPPORT

endchoice

choice
	prompt "RK3188 Board Type"
	depends on SOC_RK3188

config MACH_RK3188_TB
	bool "RK3188 Top Board"

config MACH_RK3188_SDK
	bool "RK3188 sdk Board"

config MACH_RK3188_FPGA
	bool "RK3188 FPGA board"
	select RK_FPGA

config MACH_RK3188_LR097
        bool "RK3188 LR097 JC21CA board"

config MACH_RK3188_DS1006H
	bool "RK3188 ds1006h board"
        
config MACH_RK3188_FAC
        bool "RK3188 Board for factory"
        select MACH_RK_FAC


config MACH_RK3188_PHONEPAD
    bool "RK3188 phonepad board"
   

config MACH_RK3188_RK618_3G
    bool "RK3188 RK618 AND 3G public board"
endchoice

choice
	prompt "CPU frequency table"
	depends on MACH_RK3188_PHONEPAD

config CPUFREQ_TABLE_DEFAULT
	bool "Default"
	help
	  Default level1 table. 1608 MHz unlocked for all processors.

config CPUFREQ_TABLE_OVERCLOCK
	bool "Overclock"
	help
	  Maximum CPU frequency is 1704 MHz (RK3188-T) or 1800 MHz (RK3188).
	  Added 1512 MHz intermediate frequency.

config CPUFREQ_TABLE_POWERSAVE_OVERCLOCK
	bool "Overclock with lower voltages"
	help
	  Slightly more battery life. Might cause instabilities.
	  Minimum frequency at 252 MHz.

endchoice 
```
